/*
 * Copyright (C) 2014 Gumstix, Inc. - https://www.gumstix.com/
 *
 * This program is free software; you can redistribute it and/or modify
 * it under the terms of the GNU General Public License version 2 as
 * published by the Free Software Foundation.
 */

/*
 * 4.3'' LCD Capacitive panel output for some Gumstix Overo boards (Arbor43C)
 * https://store.gumstix.com/index.php/products/635/
 */

#include "omap3-overo-common-lcd43.dtsi"

&ads7846reg {
	status = "disabled";
};
